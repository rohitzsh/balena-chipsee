## layers/meta-balena-chipsee/conf/machine/chipsee-ppc-cm4-70.conf
```bitbake
#@TYPE: Machine
#@NAME: chipsee-ppc-cm4-70
#@DESCRIPTION: Machine configuration for Chipsee PPC CM4 70 Board

MACHINEOVERRIDES = "raspberrypi4-64:${MACHINE}"
include conf/machine/raspberrypi4-64.conf

# because we override the raspberrypi4-64 machine which in turn is an override of raspberrypi4, we need to do the following gimmick:
# courtesy of https://github.com/balena-os/balena-jetson/pull/112/commits/9d21df6899e595b4aeab4cc9a939ae6c564c669a
MACHINEOVERRIDES := "${@'${MACHINEOVERRIDES}'.replace(':${MACHINE}',':raspberrypi4-64:${MACHINE}')}"

KERNEL_DEVICETREE:append += " \
    cs-i2c0-overlay.dtb \
    gt9xx-overlay.dtb \
    pwm-backlight-overlay.dtb \
"

RPI_EXTRA_CONFIG = " \n \
# Enable audio (loads snd_bcm2835) \n \
dtparam=audio=on \n \
# Audio \n \
gpio=6=op,dh \n \
# I2C \n \
dtoverlay=i2c0,pins_44_45 \n \
# RTC \n \
dtoverlay=i2c-rtc,ds1307,addr=0x32 \n \
# UART \n \
dtoverlay=miniuart-bt \n \
enable_uart=1 \n \
core_freq=250 \n \
dtoverlay=uart2 \n \
dtoverlay=uart3 \n \
dtoverlay=uart5 \n \
# LED \n \
dtparam=act_led_trigger=heartbeat \n \
# SD1 \n \
dtoverlay=sdio,poll_once=off \n \
# Touch \n \
dtoverlay=gt9xx,interrupt=20,reset=21 \n \
##GPIO \n \
gpio=18=op,dh \n \
dtoverlay=pwm-backlight,pin=18,func=2,pwm_0 \n \
# Follow Can fix some hardware issue \n \
hdmi_force_hotplug=1 \n \
hdmi_group=2 \n \
hdmi_drive=2 \n \
hdmi_mode=87 \n \
hdmi_timings=1024 0 160 10 160 600 0 12 1 23 0 0 0 60 0 52000000 6 \n \
hdmi_ignore_edid=0xa5000080 \n \
hdmi_pixel_encoding=1 \n \
# MCP23008 \n \
dtoverlay=mcp23017,mcp23008,addr=0x20,noints \n \
# MCP2517 \n \
dtoverlay=mcp2515-can0,oscillator=8000000,interrupt=16 \n \
# USB \n \
dtoverlay=dwc2,dr_mode=host \n \
"
```

## layers/meta-balena-chipsee/conf/machine/chipsee-ppc-cm4.conf
```bitbake
#@TYPE: Machine
#@NAME: chipsee-ppc-cm4
#@DESCRIPTION: Machine configuration for Chipsee PPC CM4 Board

include conf/machine/raspberrypicm4-ioboard.conf
include conf/machine/include/chipsee-ppc-cm4.inc
```

## layers/meta-balena-chipsee/conf/machine/include/chipsee-ppc-cm4.inc
```bitbake
IMAGE_INSTALL:append = " cslcd"
IMAGE_INSTALL:append = " gt9xx"
IMAGE_INSTALL:append = " lsm6ds3"

KERNEL_DEVICETREE:append = " overlays/gt9xx.dtbo"
KERNEL_DEVICETREE:append = " overlays/cs-i2c0.dtbo"
KERNEL_DEVICETREE:append = " overlays/pwm-backlight.dtbo"

ENABLE_DWC2_HOST = "1"
GPU_MEM = "64"
GPU_MEM_256 = "126"
GPU_MEM_512 = "256"
GPU_MEM_1024 = "512"
ENABLE_UART = "1"
```
